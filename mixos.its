## mixos.its
```
/dts-v1/;

/ {
	description = "mixos";
	#address-cells = <1>;

	images {
		kernel {
			description = "kernel";
			data = /incbin/("./kernel.lzma");
			type = "kernel";
			arch = "arm64";
			os = "linux";
			compression = "lzma";
			load = <0x4a000000>;
			entry = <0x4a000000>;
			hash-1 {
				algo = "sha256";
			};
		};

		ramdisk {
			description = "initrd";
			data = /incbin/("./initrd");
			type = "ramdisk";
			arch = "arm64";
			os = "linux";
			compression = "none";
			hash-1 {
				algo = "sha256";
			};
		};

		fdt {
			description = "dtb";
			data = /incbin/("./mt7981b-openwrt-one.dtb");
			type = "flat_dt";
			arch = "arm64";
			compression = "none";
			hash-1 {
				algo = "sha256";
			};
		};
	};

	configurations {
		default = "config";
		config {
			kernel = "kernel";
			fdt = "fdt";
			ramdisk = "ramdisk";
		};
	};
};
```
